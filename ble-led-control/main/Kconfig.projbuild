## ble-led-control/main/Kconfig.projbuild
```kconfig
menu "App LED BT Controller Configuration"

    config APP_LED_BT_CONTROLLER_BT_NAME
        string "Bluetooth Device Name"
        default "ESP32_BT_LED_CTRL"
        help
            The Bluetooth device name that will be advertised by the ESP32.

    menu "LED Config"

        config APP_LED_BT_CONTROLLER_LED_PIN
            int "LED GPIO Pin Number"
            default 8
            help
                GPIO pin number connected to the LED.
                Super Mini built-in LED is usually GPIO 8.

        choice
            prompt "LED Active Level"
            default APP_LED_BT_CONTROLLER_LED_ACTIVE_LOW
            help
                Determines what voltage level turns the LED on.
                Super Mini built-in LED is active low (low = on).

            config APP_LED_BT_CONTROLLER_LED_ACTIVE_LOW
                bool "Active Low (low voltage = LED on)"

            config APP_LED_BT_CONTROLLER_LED_ACTIVE_HIGH
                bool "Active High (high voltage = LED on)"

        endchoice

        choice
            prompt "Default LED Mode"
            default APP_LED_BT_CONTROLLER_DEFAULT_MODE_BREATH
            help
                Select the initial LED effect mode after power on.

            config APP_LED_BT_CONTROLLER_DEFAULT_MODE_BREATH
                bool "Breath Mode (PWM fading)"

            config APP_LED_BT_CONTROLLER_DEFAULT_MODE_BLINK
                bool "Blink Mode (on/off toggle)"

        endchoice
        
        config APP_LED_BT_CONTROLLER_BREATH_SPEED_MS
            int "Breath Mode Step Delay (ms)"
            default 10
            range 1 50
            help
                Delay between PWM duty changes in breath mode.
                Smaller value = faster breathing.

        config APP_LED_BT_CONTROLLER_BLINK_INTERVAL_MS
            int "Blink Mode Interval (ms)"
            default 500
            range 100 2000
            help
                Time between LED state toggles in blink mode.

    endmenu

endmenu
```

## desktop-gadget/main/Kconfig.projbuild
```kconfig
menu "Desktop Gadget Configuration"

    menu "WiFi Configuration"
        config APP_DESKTOP_GADGET_WIFI_SSID
            string "WiFi SSID"
            default "myssid"
            help
                WiFi网络名称（SSID），设备将连接到此网络进行网络授时。

        config APP_DESKTOP_GADGET_WIFI_PASSWORD
            string "WiFi Password"
            default "mypassword"
            help
                WiFi网络密码。
    endmenu

    menu "NTP Time Sync Configuration"
        config APP_DESKTOP_GADGET_NTP_SERVER1
            string "Primary NTP Server"
            default "ntp.aliyun.com"
            help
                主NTP授时服务器地址。
                常用的NTP服务器：
                - ntp.aliyun.com (阿里云，国内推荐)
                - ntp.tencent.com (腾讯云)
                - ntp1.aliyun.com ~ ntp7.aliyun.com (阿里云集群)
                - pool.ntp.org (国际NTP池)
                - time.windows.com (微软)
                - time.apple.com (苹果)

        config APP_DESKTOP_GADGET_NTP_SERVER2
            string "Secondary NTP Server"
            default "ntp.tencent.com"
            help
                备用NTP授时服务器地址，当主服务器不可用时使用。

        config APP_DESKTOP_GADGET_NTP_SERVER3
            string "Tertiary NTP Server"
            default "pool.ntp.org"
            help
                第三备选NTP授时服务器地址。

        config APP_DESKTOP_GADGET_NTP_GMT_OFFSET
            int "GMT Offset (seconds)"
            default 28800
            help
                相对于UTC的时区偏移量（单位：秒）。
                28800 = UTC+8（中国标准时间 CST）
                0 = UTC+0（格林威治标准时间 GMT）
                -18000 = UTC-5（美国东部时间 EST）
                3600 = UTC+1（中欧时间 CET）

        config APP_DESKTOP_GADGET_NTP_DAYLIGHT_OFFSET
            int "Daylight Saving Time Offset (seconds)"
            default 0
            help
                夏令时偏移量（单位：秒）。
                中国不使用夏令时，保持为0即可。
                美国夏令时通常为 3600（1小时）。
    endmenu

endmenu
```

## led-pwm/main/Kconfig.projbuild
```kconfig
menu "App LED PWM Configuration"

    menu "GPIO Configuration"
        help
            Configure the physical connection of the LED to the ESP32 chip.

        config APP_LED_PWM_GPIO_PIN
            int "GPIO Pin Number"
            range 1 100
            default 8
            help 
                The GPIO pin number that the LED is connected to.
                
                Important:
                - This pin will be configured as an output for the PWM signal.
                - Ensure the chosen pin is not used by any other peripheral
                  (e.g., UART, SPI, I2C) and is capable of PWM output.
                - On ESP32, pins 34-39 are input-only and cannot be used here.

        choice
            prompt "LED Active Level"
            default APP_LED_PWM_GPIO_ACTIVE_HIGH
            help
                Determines what voltage level on the GPIO pin turns the LED on.
                
                This setting depends on your LED wiring:
                - If the LED's anode (long leg) is connected to the GPIO and
                  cathode (short leg) to GND, choose "Active High".
                - If the LED's cathode is connected to the GPIO and anode to VCC
                  (3.3V or 5V), choose "Active Low".
                
                The code will internally adjust the PWM duty cycle so that the
                brightness behavior is consistent regardless of your wiring.

            config APP_LED_PWM_GPIO_ACTIVE_LOW
                bool "Active Low (low voltage = LED on)"

            config APP_LED_PWM_GPIO_ACTIVE_HIGH
                bool "Active High (high voltage = LED on)"

        endchoice
    endmenu

    menu "LEDC Configuration"
        help
            Configure the LEDC (LED PWM Controller) peripheral. The LEDC module
            generates the PWM signal that controls LED brightness.

        config APP_LED_PWM_LEDC_TIMER
            int "LEDC Timer No. (0-3)"
            range 0 3
            default 0
            help 
                Select which LEDC hardware timer to use. The ESP32 has 4 timers
                (0 to 3). Each timer can drive multiple channels at the same
                frequency but with independent duty cycles.
                
                If you plan to use other PWM outputs in your project, choose a
                timer that is not already in use.

        config APP_LED_PWM_LEDC_CHANNEL
            int "LEDC Channel No. (0-7)"
            range 0 7
            default 0
            help 
                Select which LEDC channel to use. The ESP32 provides 8 channels
                (0-7) that can be bound to any timer. The channel determines
                which GPIO will output the PWM signal (set separately).
                
                Again, avoid channels already used by other parts of your code.

        config APP_LED_PWM_LEDC_PWM_FREQUENCY
            int "PWM Frequency (Hz)"
            default 5000
            help 
                The frequency of the PWM signal in Hertz.
                
                For LED brightness control, a frequency above ~100 Hz is
                recommended to avoid visible flicker. Common values are:
                - 500 Hz   : Very stable, works everywhere.
                - 5000 Hz  : Smooth dimming, quiet (avoids audible noise).
                - 20000 Hz : High frequency, often used with camera.
                
                Note: The achievable frequency depends on the duty resolution
                (see resolution setting below). If you request a frequency that
                is too high for the chosen resolution, initialization will fail.

        # ========== 分辨率设置方式选择 ==========
        choice
            prompt "Duty Resolution Setting Mode"
            default APP_LED_PWM_DUTY_RES_AUTO
            help
                Choose how the duty resolution (number of discrete brightness
                steps) is determined.
                
                Duty resolution defines the granularity of brightness control.
                For example, 8-bit resolution gives 256 brightness levels,
                13-bit gives 8192 levels.
                
                Higher resolution gives smoother fading but reduces the maximum
                possible PWM frequency because the internal counter takes more
                clock cycles to complete one PWM period.
                
                Relationship formula:
                    Max Frequency = Source Clock (usually 80 MHz) / (2^Resolution)
                
                Two modes are available:
                
                [Auto Mode]
                The driver automatically selects the highest resolution that can
                still achieve your configured PWM frequency. This is the safest
                option and recommended for beginners.
                
                [Manual Mode]
                You specify the exact resolution in bits. This gives you full
                control, but you must ensure that the combination of frequency
                and resolution is valid. The code will check this and report an
                error if impossible.

            config APP_LED_PWM_DUTY_RES_AUTO
                bool "Auto (calculate from frequency)"

            config APP_LED_PWM_DUTY_RES_MANUAL
                bool "Manual (specify resolution)"

        endchoice

        config APP_LED_PWM_LEDC_DUTY_RESOLUTION
            int "Duty Resolution (bits)"
            range 1 20
            default 13
            depends on APP_LED_PWM_DUTY_RES_MANUAL
            help
                (Only available when Manual mode is selected above.)
                
                Set the duty resolution in bits. The number of brightness steps
                will be 2^Resolution.
                
                Examples:
                - 8 bits  : 256 steps, max frequency ~312.5 kHz (with 80 MHz clock)
                - 10 bits : 1024 steps, max frequency ~78 kHz
                - 12 bits : 4096 steps, max frequency ~19.5 kHz
                - 13 bits : 8192 steps, max frequency ~9.77 kHz
                - 14 bits : 16384 steps, max frequency ~4.88 kHz
                - 16 bits : 65536 steps, max frequency ~1.22 kHz
                
                Make sure your configured PWM frequency (APP_LED_PWM_LEDC_PWM_FREQUENCY)
                is less than or equal to the maximum frequency for the chosen
                resolution. If not, the application will fail with an error
                message during initialization.
                
                The ESP32 LEDC hardware supports up to 20 bits, but very high
                resolutions severely limit the frequency. For LED fading, 10-14
                bits are usually sufficient.

        config APP_LED_PWM_LEDC_FADE_TIME
            int "LED Fade Time (milliseconds)"
            default 1500
            help 
                Duration of a complete fade-in or fade-out transition, in
                milliseconds.
                
                This time is used both for fading from off to full brightness
                and from full brightness to off. A larger value creates a
                slower, smoother breathing effect; a smaller value makes the
                transition quicker.
                
                Typical values: 1000 - 3000 ms for a gentle breathing LED.
            
    endmenu

endmenu
```

## web-cam/main/Kconfig.projbuild
```kconfig
menu "App WebCam Configuration"

    # 板子类型配置
    choice APP_WEBCAM_BOARD_TYPE
        prompt "Camera Board Type"
        default APP_WEBCAM_BOARD_TYPE_ESP32_CAM
        help
            Select the hardware board. Pin definitions will be configured automatically.
        
        config APP_WEBCAM_BOARD_TYPE_ESP32_CAM
            bool "ESP32-CAM (AI-Thinker)"
        config APP_WEBCAM_BOARD_TYPE_ESP32_S3_CAM
            bool "ESP32-S3-CAM (Freenove / Standard)"
    endchoice

    menu "Camera"
        
        choice APP_WEBCAM_CAMERA_SENSOR
            prompt "Camera Sensor"
            default APP_WEBCAM_CAMERA_SENSOR_OV3660
            help
                Select he camera sensor being used.
            
            config APP_WEBCAM_CAMERA_SENSOR_OV3660
                bool "OV3660"
            config APP_WEBCAM_CAMERA_SENSOR_OV5640
                bool "OV5640"
        endchoice
        
        choice APP_WEBCAM_CAMERA_FRAME_SIZE
            prompt "Camera Frame Size"
            default APP_WEBCAM_FRAMESIZE_VGA
            help
                Select the resolution of the camera stream.
            
            config APP_WEBCAM_FRAMESIZE_QVGA
                bool "QVGA (320x240)"
            config APP_WEBCAM_FRAMESIZE_VGA
                bool "VGA (640x480)"
            config APP_WEBCAM_FRAMESIZE_HD
                bool "HD (1280x720)"
            config APP_WEBCAM_FRAMESIZE_UXGA
                bool "UXGA (1600x1200)"
            config APP_WEBCAM_FRAMESIZE_QXGA
                bool "QXGA (2048x1536)"
                
            config APP_WEBCAM_FRAMESIZE_QHD
                bool "QHD (2560x1440)"
                depends on APP_WEBCAM_CAMERA_SENSOR_OV5640
                
            config APP_WEBCAM_FRAMESIZE_5MP
                bool "5MP (2592x1944)"
                depends on APP_WEBCAM_CAMERA_SENSOR_OV5640
        endchoice

        config APP_WEBCAM_CAMERA_MAX_FPS
            int "Camera Max FPS"
            range 1 25
            default 10
            help 
                Max FPS of the camera

        config APP_WEBCAM_CAMERA_QUALITY
            int "JPEG Quality"
            range 10 63
            default 12
            help 
                JPEG quality, smaller means better
        
        config APP_WEBCAM_CAMERA_XCLK_FREQ_MHZ
            int "Camera XCLK Freq (mhz)"
            range 1 40
            default 10
            help 
                Camera config of "xclk_freq_hz" in mhz
    endmenu

    menu "Wifi"
        config APP_WEBCAM_WIFI_SSID
            string "Wifi SSID"
            default "my_ssid"
            help
                The SSID (name) of the WiFi network to connect to.
        
        config APP_WEBCAM_WIFI_PASSWORD
            string "Wifi Password"
            default ""
            help 
                The password of the WiFi network to connect to.
        
        config APP_WEBCAM_WIFI_USE_STATIC_IP
            bool "Use Static IP"
            default y
            help
                If use static ip for this network
        
        if APP_WEBCAM_WIFI_USE_STATIC_IP
            config APP_WEBCAM_WIFI_STATIC_IP
                string "Static IP"
                default "192.168.1.201"
                help
                    Static ip address
            
            config APP_WEBCAM_STATIC_GATEWAY
                string "Gateway Address"
                default "192.168.1.1"
                help
                    Static gateway
            
            config APP_WEBCAM_STATIC_NETMASK
                string "Netmask"
                default "255.255.255.0"
                help
                    Static Netmask
            
            config APP_WEBCAM_STATIC_DNS
                string "DNS"
                default "192.168.1.1"
                help
                    Static DNS
        endif
                    
    endmenu
    
    menu "Httpd"
        config APP_WEBCAM_HTTPD_PORT
            int "Httpd Server Port"
            default 80
            help
                Port of the httpd server
    endmenu
endmenu
```
